## config/west.yml
```yaml
manifest:
  defaults:
    revision: v0.3
  remotes:
    - name: zmkfirmware
      url-base: https://github.com/zmkfirmware
    # Additional modules containing boards/shields/custom code can be listed here as well
    # See https://docs.zephyrproject.org/3.2.0/develop/west/manifest.html#projects
    - name: temper-zmk-config
      url-base: https://github.com/raeedcho
  projects:
    - name: zmk
      remote: zmkfirmware
      import: app/west.yml
    - name: temper-zmk-config
      remote: temper-zmk-config
      revision: main
  self:
    path: config
```
